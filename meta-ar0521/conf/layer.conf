## meta-ar0521/conf/layer.conf
```bitbake
# We have a conf and classes directory, add to BBPATH
BBPATH .= ":${LAYERDIR}"

# We have recipes-* directories, add to BBFILES
BBFILES += "${LAYERDIR}/recipes-*/*/*.bb \
            ${LAYERDIR}/recipes-*/*/*.bbappend"

BBFILE_COLLECTIONS += "meta-econ"
BBFILE_PATTERN_meta-econ = "^${LAYERDIR}/"
BBFILE_PRIORITY_meta-econ = "6"

LAYERDEPENDS_meta-econ = "core"
LAYERSERIES_COMPAT_meta-econ = "kirkstone"

TEZI_EXTERNAL_KERNEL_DEVICETREE_ADDED:apalis-imx8 = " apalis-imx8_ar0521_overlay.dtbo "
TEZI_EXTERNAL_KERNEL_DEVICETREE_BOOT:append:apalis-imx8 = " apalis-imx8_ar0521_overlay.dtbo "

TEZI_EXTERNAL_KERNEL_DEVICETREE_ADDED:verdin-imx8mm = " verdin-imx8mm_ar0521_overlay.dtbo "
TEZI_EXTERNAL_KERNEL_DEVICETREE_BOOT:append:verdin-imx8mm = " verdin-imx8mm_ar0521_overlay.dtbo "

TEZI_EXTERNAL_KERNEL_DEVICETREE_ADDED:verdin-imx8mp = " verdin-imx8mp_ar0521_overlay.dtbo "
TEZI_EXTERNAL_KERNEL_DEVICETREE_BOOT:append:verdin-imx8mp = " verdin-imx8mp_ar0521_overlay.dtbo "
TEZI_EXTERNAL_KERNEL_DEVICETREE_ADDED:verdin-imx8mp = " verdin-imx8mp_mezzanine_ar0521_overlay.dtbo "
TEZI_EXTERNAL_KERNEL_DEVICETREE_ADDED:verdin-imx8mp = " verdin-imx8mp_mezzanine_ar0521-alt-jumpers_overlay.dtbo "
```
